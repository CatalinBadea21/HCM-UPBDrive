;
; File Name: cyfitterrv.inc
; 
; PSoC Creator  4.4
;
; Description:
; 
;
;-------------------------------------------------------------------------------
; Copyright (c) 2007-2020 Cypress Semiconductor.  All rights reserved.
; You may use this file only in accordance with the license, terms, conditions, 
; disclaimers, and limitations in the end user license agreement accompanying 
; the software package with which this file was provided.
;-------------------------------------------------------------------------------

    IF :LNOT::DEF:INCLUDED_CYFITTERRV_INC
INCLUDED_CYFITTERRV_INC EQU 1
    GET cydevicerv.inc
    GET cydevicerv_trm.inc

; CAN
CAN_CanIP__CSR_BUF_SR EQU CYREG_CAN0_CSR_BUF_SR
CAN_CanIP__CSR_CFG EQU CYREG_CAN0_CSR_CFG
CAN_CanIP__CSR_CMD EQU CYREG_CAN0_CSR_CMD
CAN_CanIP__CSR_ERR_SR EQU CYREG_CAN0_CSR_ERR_SR
CAN_CanIP__CSR_INT_EN EQU CYREG_CAN0_CSR_INT_EN
CAN_CanIP__CSR_INT_SR EQU CYREG_CAN0_CSR_INT_SR
CAN_CanIP__PM_ACT_CFG EQU CYREG_PM_ACT_CFG6
CAN_CanIP__PM_ACT_MSK EQU 0x01
CAN_CanIP__PM_STBY_CFG EQU CYREG_PM_STBY_CFG6
CAN_CanIP__PM_STBY_MSK EQU 0x01
CAN_CanIP__RX0_ACR EQU CYREG_CAN0_RX0_ACR
CAN_CanIP__RX0_ACRD EQU CYREG_CAN0_RX0_ACRD
CAN_CanIP__RX0_AMR EQU CYREG_CAN0_RX0_AMR
CAN_CanIP__RX0_AMRD EQU CYREG_CAN0_RX0_AMRD
CAN_CanIP__RX0_CMD EQU CYREG_CAN0_RX0_CMD
CAN_CanIP__RX0_DH EQU CYREG_CAN0_RX0_DH
CAN_CanIP__RX0_DL EQU CYREG_CAN0_RX0_DL
CAN_CanIP__RX0_ID EQU CYREG_CAN0_RX0_ID
CAN_CanIP__RX1_ACR EQU CYREG_CAN0_RX1_ACR
CAN_CanIP__RX1_ACRD EQU CYREG_CAN0_RX1_ACRD
CAN_CanIP__RX1_AMR EQU CYREG_CAN0_RX1_AMR
CAN_CanIP__RX1_AMRD EQU CYREG_CAN0_RX1_AMRD
CAN_CanIP__RX1_CMD EQU CYREG_CAN0_RX1_CMD
CAN_CanIP__RX1_DH EQU CYREG_CAN0_RX1_DH
CAN_CanIP__RX1_DL EQU CYREG_CAN0_RX1_DL
CAN_CanIP__RX1_ID EQU CYREG_CAN0_RX1_ID
CAN_CanIP__RX10_ACR EQU CYREG_CAN0_RX10_ACR
CAN_CanIP__RX10_ACRD EQU CYREG_CAN0_RX10_ACRD
CAN_CanIP__RX10_AMR EQU CYREG_CAN0_RX10_AMR
CAN_CanIP__RX10_AMRD EQU CYREG_CAN0_RX10_AMRD
CAN_CanIP__RX10_CMD EQU CYREG_CAN0_RX10_CMD
CAN_CanIP__RX10_DH EQU CYREG_CAN0_RX10_DH
CAN_CanIP__RX10_DL EQU CYREG_CAN0_RX10_DL
CAN_CanIP__RX10_ID EQU CYREG_CAN0_RX10_ID
CAN_CanIP__RX11_ACR EQU CYREG_CAN0_RX11_ACR
CAN_CanIP__RX11_ACRD EQU CYREG_CAN0_RX11_ACRD
CAN_CanIP__RX11_AMR EQU CYREG_CAN0_RX11_AMR
CAN_CanIP__RX11_AMRD EQU CYREG_CAN0_RX11_AMRD
CAN_CanIP__RX11_CMD EQU CYREG_CAN0_RX11_CMD
CAN_CanIP__RX11_DH EQU CYREG_CAN0_RX11_DH
CAN_CanIP__RX11_DL EQU CYREG_CAN0_RX11_DL
CAN_CanIP__RX11_ID EQU CYREG_CAN0_RX11_ID
CAN_CanIP__RX12_ACR EQU CYREG_CAN0_RX12_ACR
CAN_CanIP__RX12_ACRD EQU CYREG_CAN0_RX12_ACRD
CAN_CanIP__RX12_AMR EQU CYREG_CAN0_RX12_AMR
CAN_CanIP__RX12_AMRD EQU CYREG_CAN0_RX12_AMRD
CAN_CanIP__RX12_CMD EQU CYREG_CAN0_RX12_CMD
CAN_CanIP__RX12_DH EQU CYREG_CAN0_RX12_DH
CAN_CanIP__RX12_DL EQU CYREG_CAN0_RX12_DL
CAN_CanIP__RX12_ID EQU CYREG_CAN0_RX12_ID
CAN_CanIP__RX13_ACR EQU CYREG_CAN0_RX13_ACR
CAN_CanIP__RX13_ACRD EQU CYREG_CAN0_RX13_ACRD
CAN_CanIP__RX13_AMR EQU CYREG_CAN0_RX13_AMR
CAN_CanIP__RX13_AMRD EQU CYREG_CAN0_RX13_AMRD
CAN_CanIP__RX13_CMD EQU CYREG_CAN0_RX13_CMD
CAN_CanIP__RX13_DH EQU CYREG_CAN0_RX13_DH
CAN_CanIP__RX13_DL EQU CYREG_CAN0_RX13_DL
CAN_CanIP__RX13_ID EQU CYREG_CAN0_RX13_ID
CAN_CanIP__RX14_ACR EQU CYREG_CAN0_RX14_ACR
CAN_CanIP__RX14_ACRD EQU CYREG_CAN0_RX14_ACRD
CAN_CanIP__RX14_AMR EQU CYREG_CAN0_RX14_AMR
CAN_CanIP__RX14_AMRD EQU CYREG_CAN0_RX14_AMRD
CAN_CanIP__RX14_CMD EQU CYREG_CAN0_RX14_CMD
CAN_CanIP__RX14_DH EQU CYREG_CAN0_RX14_DH
CAN_CanIP__RX14_DL EQU CYREG_CAN0_RX14_DL
CAN_CanIP__RX14_ID EQU CYREG_CAN0_RX14_ID
CAN_CanIP__RX15_ACR EQU CYREG_CAN0_RX15_ACR
CAN_CanIP__RX15_ACRD EQU CYREG_CAN0_RX15_ACRD
CAN_CanIP__RX15_AMR EQU CYREG_CAN0_RX15_AMR
CAN_CanIP__RX15_AMRD EQU CYREG_CAN0_RX15_AMRD
CAN_CanIP__RX15_CMD EQU CYREG_CAN0_RX15_CMD
CAN_CanIP__RX15_DH EQU CYREG_CAN0_RX15_DH
CAN_CanIP__RX15_DL EQU CYREG_CAN0_RX15_DL
CAN_CanIP__RX15_ID EQU CYREG_CAN0_RX15_ID
CAN_CanIP__RX2_ACR EQU CYREG_CAN0_RX2_ACR
CAN_CanIP__RX2_ACRD EQU CYREG_CAN0_RX2_ACRD
CAN_CanIP__RX2_AMR EQU CYREG_CAN0_RX2_AMR
CAN_CanIP__RX2_AMRD EQU CYREG_CAN0_RX2_AMRD
CAN_CanIP__RX2_CMD EQU CYREG_CAN0_RX2_CMD
CAN_CanIP__RX2_DH EQU CYREG_CAN0_RX2_DH
CAN_CanIP__RX2_DL EQU CYREG_CAN0_RX2_DL
CAN_CanIP__RX2_ID EQU CYREG_CAN0_RX2_ID
CAN_CanIP__RX3_ACR EQU CYREG_CAN0_RX3_ACR
CAN_CanIP__RX3_ACRD EQU CYREG_CAN0_RX3_ACRD
CAN_CanIP__RX3_AMR EQU CYREG_CAN0_RX3_AMR
CAN_CanIP__RX3_AMRD EQU CYREG_CAN0_RX3_AMRD
CAN_CanIP__RX3_CMD EQU CYREG_CAN0_RX3_CMD
CAN_CanIP__RX3_DH EQU CYREG_CAN0_RX3_DH
CAN_CanIP__RX3_DL EQU CYREG_CAN0_RX3_DL
CAN_CanIP__RX3_ID EQU CYREG_CAN0_RX3_ID
CAN_CanIP__RX4_ACR EQU CYREG_CAN0_RX4_ACR
CAN_CanIP__RX4_ACRD EQU CYREG_CAN0_RX4_ACRD
CAN_CanIP__RX4_AMR EQU CYREG_CAN0_RX4_AMR
CAN_CanIP__RX4_AMRD EQU CYREG_CAN0_RX4_AMRD
CAN_CanIP__RX4_CMD EQU CYREG_CAN0_RX4_CMD
CAN_CanIP__RX4_DH EQU CYREG_CAN0_RX4_DH
CAN_CanIP__RX4_DL EQU CYREG_CAN0_RX4_DL
CAN_CanIP__RX4_ID EQU CYREG_CAN0_RX4_ID
CAN_CanIP__RX5_ACR EQU CYREG_CAN0_RX5_ACR
CAN_CanIP__RX5_ACRD EQU CYREG_CAN0_RX5_ACRD
CAN_CanIP__RX5_AMR EQU CYREG_CAN0_RX5_AMR
CAN_CanIP__RX5_AMRD EQU CYREG_CAN0_RX5_AMRD
CAN_CanIP__RX5_CMD EQU CYREG_CAN0_RX5_CMD
CAN_CanIP__RX5_DH EQU CYREG_CAN0_RX5_DH
CAN_CanIP__RX5_DL EQU CYREG_CAN0_RX5_DL
CAN_CanIP__RX5_ID EQU CYREG_CAN0_RX5_ID
CAN_CanIP__RX6_ACR EQU CYREG_CAN0_RX6_ACR
CAN_CanIP__RX6_ACRD EQU CYREG_CAN0_RX6_ACRD
CAN_CanIP__RX6_AMR EQU CYREG_CAN0_RX6_AMR
CAN_CanIP__RX6_AMRD EQU CYREG_CAN0_RX6_AMRD
CAN_CanIP__RX6_CMD EQU CYREG_CAN0_RX6_CMD
CAN_CanIP__RX6_DH EQU CYREG_CAN0_RX6_DH
CAN_CanIP__RX6_DL EQU CYREG_CAN0_RX6_DL
CAN_CanIP__RX6_ID EQU CYREG_CAN0_RX6_ID
CAN_CanIP__RX7_ACR EQU CYREG_CAN0_RX7_ACR
CAN_CanIP__RX7_ACRD EQU CYREG_CAN0_RX7_ACRD
CAN_CanIP__RX7_AMR EQU CYREG_CAN0_RX7_AMR
CAN_CanIP__RX7_AMRD EQU CYREG_CAN0_RX7_AMRD
CAN_CanIP__RX7_CMD EQU CYREG_CAN0_RX7_CMD
CAN_CanIP__RX7_DH EQU CYREG_CAN0_RX7_DH
CAN_CanIP__RX7_DL EQU CYREG_CAN0_RX7_DL
CAN_CanIP__RX7_ID EQU CYREG_CAN0_RX7_ID
CAN_CanIP__RX8_ACR EQU CYREG_CAN0_RX8_ACR
CAN_CanIP__RX8_ACRD EQU CYREG_CAN0_RX8_ACRD
CAN_CanIP__RX8_AMR EQU CYREG_CAN0_RX8_AMR
CAN_CanIP__RX8_AMRD EQU CYREG_CAN0_RX8_AMRD
CAN_CanIP__RX8_CMD EQU CYREG_CAN0_RX8_CMD
CAN_CanIP__RX8_DH EQU CYREG_CAN0_RX8_DH
CAN_CanIP__RX8_DL EQU CYREG_CAN0_RX8_DL
CAN_CanIP__RX8_ID EQU CYREG_CAN0_RX8_ID
CAN_CanIP__RX9_ACR EQU CYREG_CAN0_RX9_ACR
CAN_CanIP__RX9_ACRD EQU CYREG_CAN0_RX9_ACRD
CAN_CanIP__RX9_AMR EQU CYREG_CAN0_RX9_AMR
CAN_CanIP__RX9_AMRD EQU CYREG_CAN0_RX9_AMRD
CAN_CanIP__RX9_CMD EQU CYREG_CAN0_RX9_CMD
CAN_CanIP__RX9_DH EQU CYREG_CAN0_RX9_DH
CAN_CanIP__RX9_DL EQU CYREG_CAN0_RX9_DL
CAN_CanIP__RX9_ID EQU CYREG_CAN0_RX9_ID
CAN_CanIP__TX0_CMD EQU CYREG_CAN0_TX0_CMD
CAN_CanIP__TX0_DH EQU CYREG_CAN0_TX0_DH
CAN_CanIP__TX0_DL EQU CYREG_CAN0_TX0_DL
CAN_CanIP__TX0_ID EQU CYREG_CAN0_TX0_ID
CAN_CanIP__TX1_CMD EQU CYREG_CAN0_TX1_CMD
CAN_CanIP__TX1_DH EQU CYREG_CAN0_TX1_DH
CAN_CanIP__TX1_DL EQU CYREG_CAN0_TX1_DL
CAN_CanIP__TX1_ID EQU CYREG_CAN0_TX1_ID
CAN_CanIP__TX2_CMD EQU CYREG_CAN0_TX2_CMD
CAN_CanIP__TX2_DH EQU CYREG_CAN0_TX2_DH
CAN_CanIP__TX2_DL EQU CYREG_CAN0_TX2_DL
CAN_CanIP__TX2_ID EQU CYREG_CAN0_TX2_ID
CAN_CanIP__TX3_CMD EQU CYREG_CAN0_TX3_CMD
CAN_CanIP__TX3_DH EQU CYREG_CAN0_TX3_DH
CAN_CanIP__TX3_DL EQU CYREG_CAN0_TX3_DL
CAN_CanIP__TX3_ID EQU CYREG_CAN0_TX3_ID
CAN_CanIP__TX4_CMD EQU CYREG_CAN0_TX4_CMD
CAN_CanIP__TX4_DH EQU CYREG_CAN0_TX4_DH
CAN_CanIP__TX4_DL EQU CYREG_CAN0_TX4_DL
CAN_CanIP__TX4_ID EQU CYREG_CAN0_TX4_ID
CAN_CanIP__TX5_CMD EQU CYREG_CAN0_TX5_CMD
CAN_CanIP__TX5_DH EQU CYREG_CAN0_TX5_DH
CAN_CanIP__TX5_DL EQU CYREG_CAN0_TX5_DL
CAN_CanIP__TX5_ID EQU CYREG_CAN0_TX5_ID
CAN_CanIP__TX6_CMD EQU CYREG_CAN0_TX6_CMD
CAN_CanIP__TX6_DH EQU CYREG_CAN0_TX6_DH
CAN_CanIP__TX6_DL EQU CYREG_CAN0_TX6_DL
CAN_CanIP__TX6_ID EQU CYREG_CAN0_TX6_ID
CAN_CanIP__TX7_CMD EQU CYREG_CAN0_TX7_CMD
CAN_CanIP__TX7_DH EQU CYREG_CAN0_TX7_DH
CAN_CanIP__TX7_DL EQU CYREG_CAN0_TX7_DL
CAN_CanIP__TX7_ID EQU CYREG_CAN0_TX7_ID
CAN_isr__INTC_CLR_EN_REG EQU CYREG_NVIC_CLRENA0
CAN_isr__INTC_CLR_PD_REG EQU CYREG_NVIC_CLRPEND0
CAN_isr__INTC_MASK EQU 0x10000
CAN_isr__INTC_NUMBER EQU 16
CAN_isr__INTC_PRIOR_NUM EQU 7
CAN_isr__INTC_PRIOR_REG EQU CYREG_NVIC_PRI_16
CAN_isr__INTC_SET_EN_REG EQU CYREG_NVIC_SETENA0
CAN_isr__INTC_SET_PD_REG EQU CYREG_NVIC_SETPEND0
CAN_RX__0__INTTYPE EQU CYREG_PICU15_INTTYPE1
CAN_RX__0__MASK EQU 0x02
CAN_RX__0__PC EQU CYREG_IO_PC_PRT15_PC1
CAN_RX__0__PORT EQU 15
CAN_RX__0__SHIFT EQU 1
CAN_RX__AG EQU CYREG_PRT15_AG
CAN_RX__AMUX EQU CYREG_PRT15_AMUX
CAN_RX__BIE EQU CYREG_PRT15_BIE
CAN_RX__BIT_MASK EQU CYREG_PRT15_BIT_MASK
CAN_RX__BYP EQU CYREG_PRT15_BYP
CAN_RX__CTL EQU CYREG_PRT15_CTL
CAN_RX__DM0 EQU CYREG_PRT15_DM0
CAN_RX__DM1 EQU CYREG_PRT15_DM1
CAN_RX__DM2 EQU CYREG_PRT15_DM2
CAN_RX__DR EQU CYREG_PRT15_DR
CAN_RX__INP_DIS EQU CYREG_PRT15_INP_DIS
CAN_RX__INTTYPE_BASE EQU CYDEV_PICU_INTTYPE_PICU15_BASE
CAN_RX__LCD_COM_SEG EQU CYREG_PRT15_LCD_COM_SEG
CAN_RX__LCD_EN EQU CYREG_PRT15_LCD_EN
CAN_RX__MASK EQU 0x02
CAN_RX__PORT EQU 15
CAN_RX__PRT EQU CYREG_PRT15_PRT
CAN_RX__PRTDSI__CAPS_SEL EQU CYREG_PRT15_CAPS_SEL
CAN_RX__PRTDSI__DBL_SYNC_IN EQU CYREG_PRT15_DBL_SYNC_IN
CAN_RX__PRTDSI__OE_SEL0 EQU CYREG_PRT15_OE_SEL0
CAN_RX__PRTDSI__OE_SEL1 EQU CYREG_PRT15_OE_SEL1
CAN_RX__PRTDSI__OUT_SEL0 EQU CYREG_PRT15_OUT_SEL0
CAN_RX__PRTDSI__OUT_SEL1 EQU CYREG_PRT15_OUT_SEL1
CAN_RX__PRTDSI__SYNC_OUT EQU CYREG_PRT15_SYNC_OUT
CAN_RX__PS EQU CYREG_PRT15_PS
CAN_RX__SHIFT EQU 1
CAN_RX__SLW EQU CYREG_PRT15_SLW
CAN_TX__0__INTTYPE EQU CYREG_PICU15_INTTYPE0
CAN_TX__0__MASK EQU 0x01
CAN_TX__0__PC EQU CYREG_IO_PC_PRT15_PC0
CAN_TX__0__PORT EQU 15
CAN_TX__0__SHIFT EQU 0
CAN_TX__AG EQU CYREG_PRT15_AG
CAN_TX__AMUX EQU CYREG_PRT15_AMUX
CAN_TX__BIE EQU CYREG_PRT15_BIE
CAN_TX__BIT_MASK EQU CYREG_PRT15_BIT_MASK
CAN_TX__BYP EQU CYREG_PRT15_BYP
CAN_TX__CTL EQU CYREG_PRT15_CTL
CAN_TX__DM0 EQU CYREG_PRT15_DM0
CAN_TX__DM1 EQU CYREG_PRT15_DM1
CAN_TX__DM2 EQU CYREG_PRT15_DM2
CAN_TX__DR EQU CYREG_PRT15_DR
CAN_TX__INP_DIS EQU CYREG_PRT15_INP_DIS
CAN_TX__INTTYPE_BASE EQU CYDEV_PICU_INTTYPE_PICU15_BASE
CAN_TX__LCD_COM_SEG EQU CYREG_PRT15_LCD_COM_SEG
CAN_TX__LCD_EN EQU CYREG_PRT15_LCD_EN
CAN_TX__MASK EQU 0x01
CAN_TX__PORT EQU 15
CAN_TX__PRT EQU CYREG_PRT15_PRT
CAN_TX__PRTDSI__CAPS_SEL EQU CYREG_PRT15_CAPS_SEL
CAN_TX__PRTDSI__DBL_SYNC_IN EQU CYREG_PRT15_DBL_SYNC_IN
CAN_TX__PRTDSI__OE_SEL0 EQU CYREG_PRT15_OE_SEL0
CAN_TX__PRTDSI__OE_SEL1 EQU CYREG_PRT15_OE_SEL1
CAN_TX__PRTDSI__OUT_SEL0 EQU CYREG_PRT15_OUT_SEL0
CAN_TX__PRTDSI__OUT_SEL1 EQU CYREG_PRT15_OUT_SEL1
CAN_TX__PRTDSI__SYNC_OUT EQU CYREG_PRT15_SYNC_OUT
CAN_TX__PS EQU CYREG_PRT15_PS
CAN_TX__SHIFT EQU 0
CAN_TX__SLW EQU CYREG_PRT15_SLW

; AIR_enable
AIR_enable__0__INTTYPE EQU CYREG_PICU2_INTTYPE0
AIR_enable__0__MASK EQU 0x01
AIR_enable__0__PC EQU CYREG_PRT2_PC0
AIR_enable__0__PORT EQU 2
AIR_enable__0__SHIFT EQU 0
AIR_enable__AG EQU CYREG_PRT2_AG
AIR_enable__AMUX EQU CYREG_PRT2_AMUX
AIR_enable__BIE EQU CYREG_PRT2_BIE
AIR_enable__BIT_MASK EQU CYREG_PRT2_BIT_MASK
AIR_enable__BYP EQU CYREG_PRT2_BYP
AIR_enable__CTL EQU CYREG_PRT2_CTL
AIR_enable__DM0 EQU CYREG_PRT2_DM0
AIR_enable__DM1 EQU CYREG_PRT2_DM1
AIR_enable__DM2 EQU CYREG_PRT2_DM2
AIR_enable__DR EQU CYREG_PRT2_DR
AIR_enable__INP_DIS EQU CYREG_PRT2_INP_DIS
AIR_enable__INTTYPE_BASE EQU CYDEV_PICU_INTTYPE_PICU2_BASE
AIR_enable__LCD_COM_SEG EQU CYREG_PRT2_LCD_COM_SEG
AIR_enable__LCD_EN EQU CYREG_PRT2_LCD_EN
AIR_enable__MASK EQU 0x01
AIR_enable__PORT EQU 2
AIR_enable__PRT EQU CYREG_PRT2_PRT
AIR_enable__PRTDSI__CAPS_SEL EQU CYREG_PRT2_CAPS_SEL
AIR_enable__PRTDSI__DBL_SYNC_IN EQU CYREG_PRT2_DBL_SYNC_IN
AIR_enable__PRTDSI__OE_SEL0 EQU CYREG_PRT2_OE_SEL0
AIR_enable__PRTDSI__OE_SEL1 EQU CYREG_PRT2_OE_SEL1
AIR_enable__PRTDSI__OUT_SEL0 EQU CYREG_PRT2_OUT_SEL0
AIR_enable__PRTDSI__OUT_SEL1 EQU CYREG_PRT2_OUT_SEL1
AIR_enable__PRTDSI__SYNC_OUT EQU CYREG_PRT2_SYNC_OUT
AIR_enable__PS EQU CYREG_PRT2_PS
AIR_enable__SHIFT EQU 0
AIR_enable__SLW EQU CYREG_PRT2_SLW

; Selector_In
Selector_In__0__INTTYPE EQU CYREG_PICU3_INTTYPE0
Selector_In__0__MASK EQU 0x01
Selector_In__0__PC EQU CYREG_PRT3_PC0
Selector_In__0__PORT EQU 3
Selector_In__0__SHIFT EQU 0
Selector_In__1__INTTYPE EQU CYREG_PICU3_INTTYPE1
Selector_In__1__MASK EQU 0x02
Selector_In__1__PC EQU CYREG_PRT3_PC1
Selector_In__1__PORT EQU 3
Selector_In__1__SHIFT EQU 1
Selector_In__2__INTTYPE EQU CYREG_PICU3_INTTYPE2
Selector_In__2__MASK EQU 0x04
Selector_In__2__PC EQU CYREG_PRT3_PC2
Selector_In__2__PORT EQU 3
Selector_In__2__SHIFT EQU 2
Selector_In__3__INTTYPE EQU CYREG_PICU3_INTTYPE3
Selector_In__3__MASK EQU 0x08
Selector_In__3__PC EQU CYREG_PRT3_PC3
Selector_In__3__PORT EQU 3
Selector_In__3__SHIFT EQU 3
Selector_In__4__INTTYPE EQU CYREG_PICU3_INTTYPE4
Selector_In__4__MASK EQU 0x10
Selector_In__4__PC EQU CYREG_PRT3_PC4
Selector_In__4__PORT EQU 3
Selector_In__4__SHIFT EQU 4
Selector_In__AG EQU CYREG_PRT3_AG
Selector_In__AMUX EQU CYREG_PRT3_AMUX
Selector_In__BIE EQU CYREG_PRT3_BIE
Selector_In__BIT_MASK EQU CYREG_PRT3_BIT_MASK
Selector_In__BYP EQU CYREG_PRT3_BYP
Selector_In__CTL EQU CYREG_PRT3_CTL
Selector_In__DM0 EQU CYREG_PRT3_DM0
Selector_In__DM1 EQU CYREG_PRT3_DM1
Selector_In__DM2 EQU CYREG_PRT3_DM2
Selector_In__DR EQU CYREG_PRT3_DR
Selector_In__INP_DIS EQU CYREG_PRT3_INP_DIS
Selector_In__INTTYPE_BASE EQU CYDEV_PICU_INTTYPE_PICU3_BASE
Selector_In__LCD_COM_SEG EQU CYREG_PRT3_LCD_COM_SEG
Selector_In__LCD_EN EQU CYREG_PRT3_LCD_EN
Selector_In__MASK EQU 0x1F
Selector_In__PORT EQU 3
Selector_In__PRT EQU CYREG_PRT3_PRT
Selector_In__PRTDSI__CAPS_SEL EQU CYREG_PRT3_CAPS_SEL
Selector_In__PRTDSI__DBL_SYNC_IN EQU CYREG_PRT3_DBL_SYNC_IN
Selector_In__PRTDSI__OE_SEL0 EQU CYREG_PRT3_OE_SEL0
Selector_In__PRTDSI__OE_SEL1 EQU CYREG_PRT3_OE_SEL1
Selector_In__PRTDSI__OUT_SEL0 EQU CYREG_PRT3_OUT_SEL0
Selector_In__PRTDSI__OUT_SEL1 EQU CYREG_PRT3_OUT_SEL1
Selector_In__PRTDSI__SYNC_OUT EQU CYREG_PRT3_SYNC_OUT
Selector_In__PS EQU CYREG_PRT3_PS
Selector_In__SHIFT EQU 0
Selector_In__SLW EQU CYREG_PRT3_SLW

; Boost_Button
Boost_Button__0__INTTYPE EQU CYREG_PICU0_INTTYPE0
Boost_Button__0__MASK EQU 0x01
Boost_Button__0__PC EQU CYREG_PRT0_PC0
Boost_Button__0__PORT EQU 0
Boost_Button__0__SHIFT EQU 0
Boost_Button__AG EQU CYREG_PRT0_AG
Boost_Button__AMUX EQU CYREG_PRT0_AMUX
Boost_Button__BIE EQU CYREG_PRT0_BIE
Boost_Button__BIT_MASK EQU CYREG_PRT0_BIT_MASK
Boost_Button__BYP EQU CYREG_PRT0_BYP
Boost_Button__CTL EQU CYREG_PRT0_CTL
Boost_Button__DM0 EQU CYREG_PRT0_DM0
Boost_Button__DM1 EQU CYREG_PRT0_DM1
Boost_Button__DM2 EQU CYREG_PRT0_DM2
Boost_Button__DR EQU CYREG_PRT0_DR
Boost_Button__INP_DIS EQU CYREG_PRT0_INP_DIS
Boost_Button__INTTYPE_BASE EQU CYDEV_PICU_INTTYPE_PICU0_BASE
Boost_Button__LCD_COM_SEG EQU CYREG_PRT0_LCD_COM_SEG
Boost_Button__LCD_EN EQU CYREG_PRT0_LCD_EN
Boost_Button__MASK EQU 0x01
Boost_Button__PORT EQU 0
Boost_Button__PRT EQU CYREG_PRT0_PRT
Boost_Button__PRTDSI__CAPS_SEL EQU CYREG_PRT0_CAPS_SEL
Boost_Button__PRTDSI__DBL_SYNC_IN EQU CYREG_PRT0_DBL_SYNC_IN
Boost_Button__PRTDSI__OE_SEL0 EQU CYREG_PRT0_OE_SEL0
Boost_Button__PRTDSI__OE_SEL1 EQU CYREG_PRT0_OE_SEL1
Boost_Button__PRTDSI__OUT_SEL0 EQU CYREG_PRT0_OUT_SEL0
Boost_Button__PRTDSI__OUT_SEL1 EQU CYREG_PRT0_OUT_SEL1
Boost_Button__PRTDSI__SYNC_OUT EQU CYREG_PRT0_SYNC_OUT
Boost_Button__PS EQU CYREG_PRT0_PS
Boost_Button__SHIFT EQU 0
Boost_Button__SLW EQU CYREG_PRT0_SLW

; Miscellaneous
BCLK__BUS_CLK__HZ EQU 24000000
BCLK__BUS_CLK__KHZ EQU 24000
BCLK__BUS_CLK__MHZ EQU 24
CYDEV_CHIP_DIE_LEOPARD EQU 1
CYDEV_CHIP_DIE_PSOC4A EQU 26
CYDEV_CHIP_DIE_PSOC5LP EQU 2
CYDEV_CHIP_DIE_PSOC5TM EQU 3
CYDEV_CHIP_DIE_TMA4 EQU 4
CYDEV_CHIP_DIE_UNKNOWN EQU 0
CYDEV_CHIP_FAMILY_FM0P EQU 5
CYDEV_CHIP_FAMILY_FM3 EQU 6
CYDEV_CHIP_FAMILY_FM4 EQU 7
CYDEV_CHIP_FAMILY_PSOC3 EQU 1
CYDEV_CHIP_FAMILY_PSOC4 EQU 2
CYDEV_CHIP_FAMILY_PSOC5 EQU 3
CYDEV_CHIP_FAMILY_PSOC6 EQU 4
CYDEV_CHIP_FAMILY_UNKNOWN EQU 0
CYDEV_CHIP_FAMILY_USED EQU CYDEV_CHIP_FAMILY_PSOC5
CYDEV_CHIP_JTAG_ID EQU 0x2E161069
CYDEV_CHIP_MEMBER_3A EQU 1
CYDEV_CHIP_MEMBER_4A EQU 26
CYDEV_CHIP_MEMBER_4AA EQU 25
CYDEV_CHIP_MEMBER_4AB EQU 30
CYDEV_CHIP_MEMBER_4AC EQU 14
CYDEV_CHIP_MEMBER_4AD EQU 15
CYDEV_CHIP_MEMBER_4AE EQU 16
CYDEV_CHIP_MEMBER_4D EQU 20
CYDEV_CHIP_MEMBER_4E EQU 6
CYDEV_CHIP_MEMBER_4F EQU 27
CYDEV_CHIP_MEMBER_4G EQU 4
CYDEV_CHIP_MEMBER_4H EQU 24
CYDEV_CHIP_MEMBER_4I EQU 32
CYDEV_CHIP_MEMBER_4J EQU 21
CYDEV_CHIP_MEMBER_4K EQU 22
CYDEV_CHIP_MEMBER_4L EQU 31
CYDEV_CHIP_MEMBER_4M EQU 29
CYDEV_CHIP_MEMBER_4N EQU 11
CYDEV_CHIP_MEMBER_4O EQU 8
CYDEV_CHIP_MEMBER_4P EQU 28
CYDEV_CHIP_MEMBER_4Q EQU 17
CYDEV_CHIP_MEMBER_4R EQU 9
CYDEV_CHIP_MEMBER_4S EQU 12
CYDEV_CHIP_MEMBER_4T EQU 10
CYDEV_CHIP_MEMBER_4U EQU 5
CYDEV_CHIP_MEMBER_4V EQU 23
CYDEV_CHIP_MEMBER_4W EQU 13
CYDEV_CHIP_MEMBER_4X EQU 7
CYDEV_CHIP_MEMBER_4Y EQU 18
CYDEV_CHIP_MEMBER_4Z EQU 19
CYDEV_CHIP_MEMBER_5A EQU 3
CYDEV_CHIP_MEMBER_5B EQU 2
CYDEV_CHIP_MEMBER_6A EQU 33
CYDEV_CHIP_MEMBER_FM3 EQU 37
CYDEV_CHIP_MEMBER_FM4 EQU 38
CYDEV_CHIP_MEMBER_PDL_FM0P_TYPE1 EQU 34
CYDEV_CHIP_MEMBER_PDL_FM0P_TYPE2 EQU 35
CYDEV_CHIP_MEMBER_PDL_FM0P_TYPE3 EQU 36
CYDEV_CHIP_MEMBER_UNKNOWN EQU 0
CYDEV_CHIP_MEMBER_USED EQU CYDEV_CHIP_MEMBER_5B
CYDEV_CHIP_DIE_EXPECT EQU CYDEV_CHIP_MEMBER_USED
CYDEV_CHIP_DIE_ACTUAL EQU CYDEV_CHIP_DIE_EXPECT
CYDEV_CHIP_REV_LEOPARD_ES1 EQU 0
CYDEV_CHIP_REV_LEOPARD_ES2 EQU 1
CYDEV_CHIP_REV_LEOPARD_ES3 EQU 3
CYDEV_CHIP_REV_LEOPARD_PRODUCTION EQU 3
CYDEV_CHIP_REV_PSOC4A_ES0 EQU 17
CYDEV_CHIP_REV_PSOC4A_PRODUCTION EQU 17
CYDEV_CHIP_REV_PSOC5LP_ES0 EQU 0
CYDEV_CHIP_REV_PSOC5LP_PRODUCTION EQU 0
CYDEV_CHIP_REV_PSOC5TM_ES0 EQU 0
CYDEV_CHIP_REV_PSOC5TM_ES1 EQU 1
CYDEV_CHIP_REV_PSOC5TM_PRODUCTION EQU 1
CYDEV_CHIP_REV_TMA4_ES EQU 17
CYDEV_CHIP_REV_TMA4_ES2 EQU 33
CYDEV_CHIP_REV_TMA4_PRODUCTION EQU 17
CYDEV_CHIP_REVISION_3A_ES1 EQU 0
CYDEV_CHIP_REVISION_3A_ES2 EQU 1
CYDEV_CHIP_REVISION_3A_ES3 EQU 3
CYDEV_CHIP_REVISION_3A_PRODUCTION EQU 3
CYDEV_CHIP_REVISION_4A_ES0 EQU 17
CYDEV_CHIP_REVISION_4A_PRODUCTION EQU 17
CYDEV_CHIP_REVISION_4AA_PRODUCTION EQU 0
CYDEV_CHIP_REVISION_4AB_PRODUCTION EQU 0
CYDEV_CHIP_REVISION_4AC_PRODUCTION EQU 0
CYDEV_CHIP_REVISION_4AD_PRODUCTION EQU 0
CYDEV_CHIP_REVISION_4AE_PRODUCTION EQU 0
CYDEV_CHIP_REVISION_4D_PRODUCTION EQU 0
CYDEV_CHIP_REVISION_4E_CCG2_NO_USBPD EQU 0
CYDEV_CHIP_REVISION_4E_PRODUCTION EQU 0
CYDEV_CHIP_REVISION_4F_PRODUCTION EQU 0
CYDEV_CHIP_REVISION_4F_PRODUCTION_256DMA EQU 0
CYDEV_CHIP_REVISION_4F_PRODUCTION_256K EQU 0
CYDEV_CHIP_REVISION_4G_ES EQU 17
CYDEV_CHIP_REVISION_4G_ES2 EQU 33
CYDEV_CHIP_REVISION_4G_PRODUCTION EQU 17
CYDEV_CHIP_REVISION_4H_PRODUCTION EQU 0
CYDEV_CHIP_REVISION_4I_PRODUCTION EQU 0
CYDEV_CHIP_REVISION_4J_PRODUCTION EQU 0
CYDEV_CHIP_REVISION_4K_PRODUCTION EQU 0
CYDEV_CHIP_REVISION_4L_PRODUCTION EQU 0
CYDEV_CHIP_REVISION_4M_PRODUCTION EQU 0
CYDEV_CHIP_REVISION_4N_PRODUCTION EQU 0
CYDEV_CHIP_REVISION_4O_PRODUCTION EQU 0
CYDEV_CHIP_REVISION_4P_PRODUCTION EQU 0
CYDEV_CHIP_REVISION_4Q_PRODUCTION EQU 0
CYDEV_CHIP_REVISION_4R_PRODUCTION EQU 0
CYDEV_CHIP_REVISION_4S_PRODUCTION EQU 0
CYDEV_CHIP_REVISION_4T_PRODUCTION EQU 0
CYDEV_CHIP_REVISION_4U_PRODUCTION EQU 0
CYDEV_CHIP_REVISION_4V_PRODUCTION EQU 0
CYDEV_CHIP_REVISION_4W_PRODUCTION EQU 0
CYDEV_CHIP_REVISION_4X_PRODUCTION EQU 0
CYDEV_CHIP_REVISION_4Y_PRODUCTION EQU 0
CYDEV_CHIP_REVISION_4Z_PRODUCTION EQU 0
CYDEV_CHIP_REVISION_5A_ES0 EQU 0
CYDEV_CHIP_REVISION_5A_ES1 EQU 1
CYDEV_CHIP_REVISION_5A_PRODUCTION EQU 1
CYDEV_CHIP_REVISION_5B_ES0 EQU 0
CYDEV_CHIP_REVISION_5B_PRODUCTION EQU 0
CYDEV_CHIP_REVISION_6A_ES EQU 17
CYDEV_CHIP_REVISION_6A_NO_UDB EQU 33
CYDEV_CHIP_REVISION_6A_PRODUCTION EQU 33
CYDEV_CHIP_REVISION_FM3_PRODUCTION EQU 0
CYDEV_CHIP_REVISION_FM4_PRODUCTION EQU 0
CYDEV_CHIP_REVISION_PDL_FM0P_TYPE1_PRODUCTION EQU 0
CYDEV_CHIP_REVISION_PDL_FM0P_TYPE2_PRODUCTION EQU 0
CYDEV_CHIP_REVISION_PDL_FM0P_TYPE3_PRODUCTION EQU 0
CYDEV_CHIP_REVISION_USED EQU CYDEV_CHIP_REVISION_5B_PRODUCTION
CYDEV_CHIP_REV_EXPECT EQU CYDEV_CHIP_REVISION_USED
CYDEV_CONFIG_FASTBOOT_ENABLED EQU 1
CYDEV_CONFIG_UNUSED_IO_AllowButWarn EQU 0
CYDEV_CONFIG_UNUSED_IO EQU CYDEV_CONFIG_UNUSED_IO_AllowButWarn
CYDEV_CONFIG_UNUSED_IO_AllowWithInfo EQU 1
CYDEV_CONFIG_UNUSED_IO_Disallowed EQU 2
CYDEV_CONFIGURATION_COMPRESSED EQU 1
CYDEV_CONFIGURATION_DMA EQU 0
CYDEV_CONFIGURATION_ECC EQU 1
CYDEV_CONFIGURATION_IMOENABLED EQU CYDEV_CONFIG_FASTBOOT_ENABLED
CYDEV_CONFIGURATION_MODE_COMPRESSED EQU 0
CYDEV_CONFIGURATION_MODE EQU CYDEV_CONFIGURATION_MODE_COMPRESSED
CYDEV_CONFIGURATION_MODE_DMA EQU 2
CYDEV_CONFIGURATION_MODE_UNCOMPRESSED EQU 1
CYDEV_DEBUG_ENABLE_MASK EQU 0x20
CYDEV_DEBUG_ENABLE_REGISTER EQU CYREG_MLOGIC_DEBUG
CYDEV_DEBUGGING_DPS_Disable EQU 3
CYDEV_DEBUGGING_DPS_JTAG_4 EQU 1
CYDEV_DEBUGGING_DPS_JTAG_5 EQU 0
CYDEV_DEBUGGING_DPS_SWD EQU 2
CYDEV_DEBUGGING_DPS_SWD_SWV EQU 6
CYDEV_DEBUGGING_DPS EQU CYDEV_DEBUGGING_DPS_SWD_SWV
CYDEV_DEBUGGING_ENABLE EQU 1
CYDEV_DEBUGGING_XRES EQU 0
CYDEV_DMA_CHANNELS_AVAILABLE EQU 24
CYDEV_ECC_ENABLE EQU 0
CYDEV_HEAP_SIZE EQU 0x80
CYDEV_INSTRUCT_CACHE_ENABLED EQU 1
CYDEV_INTR_RISING EQU 0x00000000
CYDEV_IS_EXPORTING_CODE EQU 0
CYDEV_IS_IMPORTING_CODE EQU 0
CYDEV_PROJ_TYPE EQU 0
CYDEV_PROJ_TYPE_BOOTLOADER EQU 1
CYDEV_PROJ_TYPE_LAUNCHER EQU 5
CYDEV_PROJ_TYPE_LOADABLE EQU 2
CYDEV_PROJ_TYPE_LOADABLEANDBOOTLOADER EQU 4
CYDEV_PROJ_TYPE_MULTIAPPBOOTLOADER EQU 3
CYDEV_PROJ_TYPE_STANDARD EQU 0
CYDEV_PROTECTION_ENABLE EQU 0
CYDEV_STACK_SIZE EQU 0x0800
CYDEV_USE_BUNDLED_CMSIS EQU 1
CYDEV_VARIABLE_VDDA EQU 0
CYDEV_VDDA EQU 5
CYDEV_VDDA_MV EQU 5000
CYDEV_VDDD EQU 5
CYDEV_VDDD_MV EQU 5000
CYDEV_VDDIO0 EQU 5
CYDEV_VDDIO0_MV EQU 5000
CYDEV_VDDIO1 EQU 5
CYDEV_VDDIO1_MV EQU 5000
CYDEV_VDDIO2 EQU 5
CYDEV_VDDIO2_MV EQU 5000
CYDEV_VDDIO3 EQU 5
CYDEV_VDDIO3_MV EQU 5000
CYDEV_VIO0 EQU 5
CYDEV_VIO0_MV EQU 5000
CYDEV_VIO1 EQU 5
CYDEV_VIO1_MV EQU 5000
CYDEV_VIO2 EQU 5
CYDEV_VIO2_MV EQU 5000
CYDEV_VIO3 EQU 5
CYDEV_VIO3_MV EQU 5000
CYIPBLOCK_ARM_CM3_VERSION EQU 0
CYIPBLOCK_P3_ANAIF_VERSION EQU 0
CYIPBLOCK_P3_CAN_VERSION EQU 0
CYIPBLOCK_P3_CAPSENSE_VERSION EQU 0
CYIPBLOCK_P3_COMP_VERSION EQU 0
CYIPBLOCK_P3_DECIMATOR_VERSION EQU 0
CYIPBLOCK_P3_DFB_VERSION EQU 0
CYIPBLOCK_P3_DMA_VERSION EQU 0
CYIPBLOCK_P3_DRQ_VERSION EQU 0
CYIPBLOCK_P3_DSM_VERSION EQU 0
CYIPBLOCK_P3_EMIF_VERSION EQU 0
CYIPBLOCK_P3_I2C_VERSION EQU 0
CYIPBLOCK_P3_LCD_VERSION EQU 0
CYIPBLOCK_P3_LPF_VERSION EQU 0
CYIPBLOCK_P3_OPAMP_VERSION EQU 0
CYIPBLOCK_P3_PM_VERSION EQU 0
CYIPBLOCK_P3_SCCT_VERSION EQU 0
CYIPBLOCK_P3_TIMER_VERSION EQU 0
CYIPBLOCK_P3_USB_VERSION EQU 0
CYIPBLOCK_P3_VIDAC_VERSION EQU 0
CYIPBLOCK_P3_VREF_VERSION EQU 0
CYIPBLOCK_S8_GPIO_VERSION EQU 0
CYIPBLOCK_S8_IRQ_VERSION EQU 0
CYIPBLOCK_S8_SAR_VERSION EQU 0
CYIPBLOCK_S8_SIO_VERSION EQU 0
CYIPBLOCK_S8_UDB_VERSION EQU 0
DMA_CHANNELS_USED__MASK0 EQU 0x00000000
CYDEV_BOOTLOADER_ENABLE EQU 0
    ENDIF
    END
